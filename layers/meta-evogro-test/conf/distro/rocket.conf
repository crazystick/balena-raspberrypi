## layers/meta-evogro-test/conf/distro/rocket.conf
```bitbake
require conf/distro/poky.conf

DISTRO = "rocket"
DISTRO_NAME = "Rocket Linux by Evogro"
DISTRO_VERSION = "0.1"
VENDOR = "evogro"

DISTRO_FEATURES += "systemd wifi"
DISTRO_FEATURES_remove = "argp irda pcmcia zeroconf x11 ptest multiarch vulkan wayland"

VIRTUAL-RUNTIME_dev_manager = "udev"
VIRTUAL-RUNTIME_init_manager = "systemd"
DISTRO_FEATURES_BACKFILL_CONSIDERED += "sysvinit"
VIRTUAL-RUNTIME_login_manager = "busybox"
VIRTUAL-RUNTIME_syslog = ""
VIRTUAL-RUNTIME_initscripts = ""

# some default locales
IMAGE_LINGUAS ?= "en-us"

PREFERRED_VERSION_nodejs = "8.4.%"
PREFERRED_VERSION_nodejs-native = "8.4.%"
PREFERRED_VERSION_mraa = "2.0.%"
PREFERRED_VERSION_upm = "1.7.%"

ROOT_HOME = "/root"

TARGET_VENDOR = "-${VENDOR}"

SDK_VENDOR = "-${VENDOR}sdk"
SDK_VERSION := "${DISTRO_VERSION}"
SDK_NAME = "${VENDOR}-${DISTRO}-${TCLIBC}-${SDK_ARCH}-${IMAGE_BASENAME}-${TUNE_PKGARCH}"
SDKPATH = "/opt/${VENDOR}-${DISTRO}/${SDK_VERSION}"

#activate config checker
INHERIT += "sanity"

#run QA tests on builds and packages and log them
INHERIT += "insane"
QA_LOG = "1"

# Log information on images and packages
INHERIT += "buildhistory"
BUILDHISTORY_COMMIT = "1"
INHERIT += "buildstats"

# Prelink images
INHERIT += "image-prelink"

# optimize lib sizes with mklibs
INHERIT += "image-mklibs"

#run QA tests on recipes
#INHERIT += "recipe_sanity"

PACKAGE_CLASSES ?= "package_ipk"
```

## layers/meta-evogro-test/conf/layer.conf
```bitbake
# We have a conf and classes directory, add to BBPATH
BBPATH .= ":${LAYERDIR}"

# We have recipes-* directories, add to BBFILES
BBFILES += "${LAYERDIR}/recipes-*/*/*.bb \
	${LAYERDIR}/recipes-*/*/*.bbappend"

BBFILE_COLLECTIONS += "evogro"
BBFILE_PATTERN_evogro = "^${LAYERDIR}/"
BBFILE_PRIORITY_evogro = "20"

LAYERSERIES_COMPAT_evogro =  "thud warrior"
```

## layers/meta-evogro-test/conf/machine/fincm3.conf
```bitbake
#@TYPE: Machine
#@NAME: Balena Fin (CM3)
#@DESCRIPTION: Machine configuration for Balena Fin board (CM3)

MACHINEOVERRIDES = "raspberrypi3:${MACHINE}"
include conf/machine/raspberrypi-cm3.conf

RPI_EXTRA_CONFIG="dtoverlay=balena-fin"

KERNEL_DEVICETREE_append_fincm3 = " overlays/balena-fin.dtbo"

MACHINE_ESSENTIAL_EXTRA_RRECOMMENDS += "${@bb.utils.contains('SD8887_FROM_SOURCE','1','sd8887-mrvl','sd8887-mrvl-prebuilt',d)} linux-firmware-sd8887"
#MACHINE_ESSENTIAL_EXTRA_RRECOMMENDS += "kernel-module-mwifiex kernel-module-mwifiex-sdio kernel-module-btmrvl kernel-module-btmrvl_sdio"

# rtc as module: CONFIG_I2C_GPIO=m / CONFIG_I2C_ALGOBIT=m / CONFIG_RTC_DRV_DS1307=m
#MACHINE_ESSENTIAL_EXTRA_RRECOMMENDS += "kernel-module-i2c-gpio kernel-module-i2c-algo-bit kernel-module-rtc-ds1307"
```
